## board/myd_ja5d2x/myd_ja5d2xdf_qspi_uboot_defconfig
```kconfig
CONFIG_MYD_JA5D2X=y
CONFIG_RAM_256MB=y
CONFIG_DDR3=y
CONFIG_QSPI=y
CONFIG_NANDFLASH=y
CONFIG_QSPI0_IOSET_3=y
CONFIG_QSPI_4B_OPCODES=y
CONFIG_IMG_ADDRESS="0x00020000"
CONFIG_IMG_SIZE="0x00060000"
CONFIG_DEBUG=y
# CONFIG_ENTER_NWD is not set
# CONFIG_ACT8865_SET_VOLTAGE is not set
# CONFIG_DISABLE_ACT8865_I2C is not set
# CONFIG_SUSPEND_ACT8945A_CHARGER is not set
```

## board/myd_ja5d2x/myd_ja5d2xdf_uboot_defconfig
```kconfig
CONFIG_MYD_JA5D2X=y
CONFIG_RAM_256MB=y
CONFIG_DDR3=y
CONFIG_NANDFLASH=y
CONFIG_DEBUG=y
# CONFIG_ENTER_NWD is not set
# CONFIG_ACT8865_SET_VOLTAGE is not set
# CONFIG_DISABLE_ACT8865_I2C is not set
# CONFIG_SUSPEND_ACT8945A_CHARGER is not set
```

## board/myd_ja5d2x/myd_ja5d2xnd_uboot_defconfig
```kconfig
CONFIG_MYD_JA5D2X=y
CONFIG_RAM_512MB=y
CONFIG_DDR3=y
CONFIG_NANDFLASH=y
CONFIG_DEBUG=y
CONFIG_IMG_ADDRESS="0x8000"
# CONFIG_ENTER_NWD is not set
# CONFIG_ACT8865_SET_VOLTAGE is not set
# CONFIG_DISABLE_ACT8865_I2C is not set
```
